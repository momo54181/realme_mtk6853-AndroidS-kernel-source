## drivers/input/touchscreen/mediatek/hxchipset_hx83102p/Kconfig
```kconfig
config TOUCHSCREEN_HIMAX_COMMON
    tristate "HIMAX common touchscreen"
    depends on TOUCHSCREEN_HIMAX_CHIPSET
    help
      Say Y here to enable support for I2C based touchscreens.
      To compile this driver as a module, choose M here: the
      module will be called HimaxChipsetTs.

choice
    prompt "HIMAX touch IC types"
    depends on TOUCHSCREEN_HIMAX_COMMON
    default TOUCHSCREEN_HIMAX_INCELL

    config TOUCHSCREEN_HIMAX_ONCELL
        bool "HIMAX chipset on-cell function"
        depends on TOUCHSCREEN_HIMAX_COMMON
        help
          If you want to use on-cell function, you must set the config.
          If unsure, not set it.

    config TOUCHSCREEN_HIMAX_INCELL
        bool "HIMAX chipset in-cell function"
        depends on TOUCHSCREEN_HIMAX_COMMON
        help
          If you want to use in-cell function, you must set the config.
          If unsure, not set it.

endchoice

# ***************** On-cell Start *****************
config TOUCHSCREEN_HIMAX_IC_HX852xH
    tristate "HIMAX chipset HX852xH function"
    depends on TOUCHSCREEN_HIMAX_ONCELL
    help
      This enables support for HIMAX CHIPSET of HX852xH.

config TOUCHSCREEN_HIMAX_IC_HX852xG
    tristate "HIMAX chipset HX852xG function"
    depends on TOUCHSCREEN_HIMAX_ONCELL
    help
      This enables support for HIMAX CHIPSET of HX852xG.
# ***************** On-cell End *******************

# ***************** In-cell Start *****************
config TOUCHSCREEN_HIMAX_IC_HX83192
    tristate "HIMAX chipset HX83192 function"
    depends on TOUCHSCREEN_HIMAX_INCELL
    help
      This enables support for HIMAX CHIPSET of HX83192.

config TOUCHSCREEN_HIMAX_IC_HX83191
    tristate "HIMAX chipset HX83191 function"
    depends on TOUCHSCREEN_HIMAX_INCELL
    help
      This enables support for HIMAX CHIPSET of HX83191.

config TOUCHSCREEN_HIMAX_IC_HX83113
    tristate "HIMAX chipset HX83113 function"
    depends on TOUCHSCREEN_HIMAX_INCELL
    help
      This enables support for HIMAX CHIPSET of HX83113.

# More chipsets...
# ***************** In-cell End *******************

config TOUCHSCREEN_HIMAX_DEBUG
    bool "HIMAX debug function"
    depends on TOUCHSCREEN_HIMAX_INCELL || TOUCHSCREEN_HIMAX_ONCELL
    help
      This enables support for HIMAX debug function of HimaxChipsetTs.

config TOUCHSCREEN_HIMAX_INSPECT
    bool "HIMAX inspect function"
    depends on TOUCHSCREEN_HIMAX_INCELL || TOUCHSCREEN_HIMAX_ONCELL
    help
      This enables support for HIMAX INSPECT function of HimaxChipsetTs.

config TOUCHSCREEN_HIMAX_EMBEDDED_FIRMWARE
    bool "HIMAX embedded firmware function"
    depends on TOUCHSCREEN_HIMAX_INCELL || TOUCHSCREEN_HIMAX_ONCELL
    help
      This enables support for HIMAX FIRMWARE function of HimaxChipsetTs.

config HMX_DB
    bool "HIMAX driver test over Dragon Board"
    depends on TOUCHSCREEN_HIMAX_COMMON
    help
      This enables support for HIMAX COMMON function of HimaxChipsetTs.
```
